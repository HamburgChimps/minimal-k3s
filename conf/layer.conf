## conf/layer.conf
```bitbake
# We have a conf and classes directory, add to BBPATH
BBPATH .= ":${LAYERDIR}"

# We have recipes-* directories, add to BBFILES
BBFILES += "${LAYERDIR}/recipes-*/*/*.bb \
	${LAYERDIR}/recipes-*/*/*.bbappend"

BBFILE_COLLECTIONS += "minimal-k3s"
BBFILE_PATTERN_minimal-k3s = "^${LAYERDIR}/"
BBFILE_PRIORITY_minimal-k3s = "1337"

DISTRO_FEATURES_append = " systemd"
VIRTUAL-RUNTIME_init_manager = "systemd"

MACHINE_ESSENTIAL_EXTRA_RDEPENDS += "kernel-module-xt-conntrack kernel-module-nf-nat kernel-module-xt-addrtype"
```
